## arch/arm/mach-rockchip/rk3588/Kconfig
```kconfig
if ROCKCHIP_RK3588

config TARGET_EVB_RK3588
	bool "EVB_RK3588"
	select BOARD_LATE_INIT
	help
	  RK3588 EVB is a evaluation board for Rockchp RK3588.

config TARGET_NANOPC_T6_RK3399
    bool "RK3399 nanopi-r4s board"
    help
        FriendArm nanopi-r4s board

config SYS_SOC
	default "rockchip"

config SYS_MALLOC_F_LEN
	default 0x400

source board/rockchip/evb_rk3588/Kconfig
source board/rockchip/rk3588-nanopc-t6/Kconfig

endif
```

## board/rockchip/rk3588-nanopc-t6/Kconfig
```kconfig
if TARGET_NANOPC_T6_RK3399

config SYS_BOARD
	default "rk3588-nanopc-t6"

config SYS_VENDOR
	default "rockchip"

config SYS_CONFIG_NAME
	default "rk3588-nanopc-t6"

config BOARD_SPECIFIC_OPTIONS # dummy
	def_bool y

endif
```
